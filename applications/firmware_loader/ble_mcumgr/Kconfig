## applications/firmware_loader/ble_mcumgr/Kconfig
```kconfig
#
# Copyright (c) 2025 Nordic Semiconductor ASA
#
# SPDX-License-Identifier: LicenseRef-Nordic-5-Clause
#

menu "Bluetooth LE MCUmgr sample"

config APP_FIRMWARE_LOADER_BLE_DEVICE_NAME
	string "Device name"
	default "nRF_BM_MCUmgr"

config APP_FIRMWARE_LOADER_IMAGE_DECRYPTION
	bool "Decrypt MCUboot encrypted images after upload"
	depends on NRF_SECURITY && BM_STORAGE
	select PSA_WANT_ALG_ECDH
	select PSA_WANT_ALG_HKDF
	select PSA_WANT_ALG_HMAC
	select PSA_WANT_ALG_CTR
	select PSA_WANT_ALG_SHA_256
	select PSA_WANT_KEY_TYPE_ECC_KEY_PAIR_IMPORT
	select PSA_WANT_KEY_TYPE_DERIVE
	select PSA_WANT_KEY_TYPE_HMAC
	select PSA_WANT_KEY_TYPE_AES
	select PSA_WANT_ECC_MONTGOMERY_255
	select PSA_WANT_AES_KEY_SIZE_128
	select MBEDTLS_ENABLE_HEAP
	help
	  After an image has been uploaded to slot0, check whether it is encrypted (ECIES-X25519 key
	  exchange, AES-128-CTR payload, HKDF and HMAC with SHA512/256) and decrypt it in place before
	  rebooting into MCUboot. The decryption uses MCUboot's own code from
	  bootloader/mcuboot/boot/bootutil. The algorithm parameters are fixed at build time and must
	  match the imgtool options used when encrypting (--hmac-sha 512/256, 128 bit AES).

	  The device private key is read from a key record in the last bytes of the boot partition.
	  It is placed there by sysbuild (SB_CONFIG_BM_FIRMWARE_LOADER_IMAGE_DECRYPTION), which also
	  enables this option; a stand-alone build of the loader has no key.

if APP_FIRMWARE_LOADER_IMAGE_DECRYPTION

config APP_FIRMWARE_LOADER_ENC_CHUNK_SIZE
	int "Size of the decryption work buffer in bytes"
	default 512
	range 16 4096
	help
	  Must be a multiple of 16.

endif # APP_FIRMWARE_LOADER_IMAGE_DECRYPTION

if MBEDTLS_ENABLE_HEAP

# PSA allocates the key slots of the imported keys, as well as operation contexts, on this heap.
config MBEDTLS_HEAP_SIZE
	default 2048 if APP_FIRMWARE_LOADER_IMAGE_DECRYPTION

endif # MBEDTLS_ENABLE_HEAP

module=APP
module-str=Bluetooth LE MCUmgr Sample
source "$(ZEPHYR_BASE)/subsys/logging/Kconfig.template.log_config"

endmenu # "Bluetooth LE MCUmgr sample"

source "Kconfig.zephyr"
```
